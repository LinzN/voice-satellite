/*
 * Copyright (c) 2026 MirraNET, Niklas Linz. All rights reserved.
 *
 * This file is part of the MirraNET project and is licensed under the
 * GNU Lesser General Public License v3.0 (LGPLv3).
 *
 * Mirra voice satellite firmware for the Onju Voice V3 board (Google Home Mini shell).
 *
 * Tap the center pad to talk to Mirra, tap again to stop, tap while she speaks to interrupt.
 * Left / right pad: volume down / up. The hardware mute switch turns the microphone off.
 * Audio goes over plain TCP to the voice-satellite plugin of STEM; the plugin does the
 * speech detection, transcription, Mirra and text to speech.
 *
 * Board: ESP32S3 Dev Module, PSRAM: OPI PSRAM, Flash: 16MB (works with 4MB as well).
 * Library: Adafruit NeoPixel.
 */

#include <Arduino.h>
#include <WiFi.h>
#include <ArduinoOTA.h>
#include <Preferences.h>
#include <Adafruit_NeoPixel.h>
#include <driver/i2s.h>
#include <mbedtls/md.h>
#include <esp_mac.h>
#include <freertos/stream_buffer.h>

#include "board.h"
#include "protocol.h"
#if __has_include("config.h")
#include "config.h"
#else
#error "Copy config.example.h to config.h and fill in your Wi-Fi and server settings"
#endif

#define FIRMWARE_VERSION "1.1.0"

/* wake word defaults for config.h files of older versions */
#ifndef WAKE_WORD_ENABLED
#define WAKE_WORD_ENABLED 1
#endif
#ifndef WAKE_WORD_CUTOFF
#define WAKE_WORD_CUTOFF 0.90f
#endif
#ifndef WAKE_WORD_WINDOW
#define WAKE_WORD_WINDOW 5
#endif

/* the model is compiled in when hey_mirra_model.h exists (generated by the training, see "Wake word" in the README) */
#if WAKE_WORD_ENABLED && __has_include("hey_mirra_model.h")
#include "hey_mirra_model.h"
#include "wakeword.h"
#define HAS_WAKE_WORD 1
#else
#define HAS_WAKE_WORD 0
#endif

/* ------------------------------------------------------------------ audio constants */
#define SAMPLE_RATE 16000
#define I2S_PORT I2S_NUM_0
#define MIC_CHUNK 256                      // samples per i2s read (16 ms)
#define MIC_FRAME 512                      // samples per AUDIO frame (32 ms)
#define PLAY_BUFFER_SECONDS 90
#define PLAY_BUFFER_SAMPLES (SAMPLE_RATE * PLAY_BUFFER_SECONDS)
#define MAX_LISTEN_MS 20000                // hard limit if the server never sends STOP_LISTEN
#define THINKING_TIMEOUT_MS 60000          // give up waiting for an answer
#define SPEAKER_OFF_DELAY_MS 3000          // amplifier shutdown after playback (less hiss)
#define MIC_BLANK_MS 150                   // microphone ignored after a sound (echo of the beep in the DMA buffers)
#ifndef MIC_GAIN
/* gain relative to the original Onju firmware (raw >> 14) */
#define MIC_GAIN 2.0f
#endif
/* Single high bits of the I2S words of the Onju V3 microphone are unreliable: depending on the DC level (large
 * offset around 0xF2000000..0xFB000000) the raw value jumps by exactly 2^25 or 2^26 between two samples. Such
 * jumps are impossible for audio, so every sample is moved by a multiple of 2^25 to the value closest to the
 * previous one. */
#define MIC_WRAP (1LL << 25)
#ifndef MIC_SLOT
/* -1: find the slot with the microphone at start (the real INMP441 data has noise in its low bits), 0 or 1: fixed */
#define MIC_SLOT -1
#endif

/* ------------------------------------------------------------------ state */
enum DeviceState : uint8_t { ST_OFFLINE, ST_IDLE, ST_LISTENING, ST_THINKING, ST_SPEAKING, ST_PENDING, ST_DENIED };

static volatile DeviceState state = ST_OFFLINE;
static volatile bool muted = false;
static volatile uint32_t stateSince = 0;
static volatile uint8_t volumeLevel = DEFAULT_VOLUME;   // 0..10
static volatile int32_t volumeGain = 0;                 // multiplier for 16 bit samples
static volatile uint8_t micLevel = 0;                   // 0..255 for the LEDs
static volatile uint8_t speakerLevel = 0;               // 0..255 for the LEDs
static volatile uint32_t flashUntil = 0;                // short LED feedback
static volatile uint32_t flashColor = 0;
static volatile uint32_t volumeShownUntil = 0;

static String deviceId;
static String serverName = DEVICE_NAME;

/* playback ring buffer in PSRAM: single producer (network task), single consumer (audio task) */
static int16_t *playBuffer = nullptr;
static volatile uint32_t playHead = 0;     // written by network task
static volatile uint32_t playTail = 0;     // written by audio task
static volatile bool playEndReceived = false;
static volatile bool listenAfterPlay = false;
static volatile bool discardPlay = false;  // drop PLAY frames until the next PLAY_END (after an interrupt)
static volatile bool clearPlayRequest = false;
static volatile uint32_t chimeSamples = 0; // locally generated feedback tone
static volatile uint16_t chimeFrequency = 880;

static WiFiClient client;
static SemaphoreHandle_t sendMutex;
static volatile bool connected = false;
static volatile uint32_t lastServerData = 0;

static Adafruit_NeoPixel leds(LED_COUNT, LED_PIN, NEO_GRB + NEO_KHZ800);
static Preferences prefs;

/* ------------------------------------------------------------------ prototypes */
static void setState(DeviceState next);
static bool sendFrame(uint8_t type, const uint8_t *payload, uint32_t length);
static bool sendJson(uint8_t type, const String &json);
static void sendEvent(const char *event);
static void startListening(bool byWakeWord = false);
static void stopListening(bool userStopped);
static void interruptSpeaking();
static void setVolume(int level, bool save);
static void flash(uint8_t r, uint8_t g, uint8_t b, uint32_t ms);
static void chime(uint16_t frequency, uint32_t ms);

/* ------------------------------------------------------------------ small helpers */
static uint32_t playAvailable() {
  return (playHead + PLAY_BUFFER_SAMPLES - playTail) % PLAY_BUFFER_SAMPLES;
}

static uint32_t playFree() {
  return PLAY_BUFFER_SAMPLES - 1 - playAvailable();
}

static String jsonEscape(const String &value) {
  String out;
  out.reserve(value.length() + 8);
  for (size_t i = 0; i < value.length(); i++) {
    char c = value[i];
    if (c == '"' || c == '\\') {
      out += '\\';
      out += c;
    } else if ((uint8_t)c < 0x20) {
      char buf[8];
      snprintf(buf, sizeof(buf), "\\u%04x", c);
      out += buf;
    } else {
      out += c;
    }
  }
  return out;
}

/* Minimal JSON lookup for the flat objects the server sends. */
static String jsonString(const String &json, const char *key) {
  String pattern = String("\"") + key + "\"";
  int at = json.indexOf(pattern);
  if (at < 0) return "";
  at = json.indexOf(':', at + pattern.length());
  if (at < 0) return "";
  at++;
  while (at < (int)json.length() && json[at] == ' ') at++;
  if (at >= (int)json.length()) return "";
  if (json[at] == '"') {
    String out;
    for (int i = at + 1; i < (int)json.length(); i++) {
      char c = json[i];
      if (c == '\\' && i + 1 < (int)json.length()) {
        out += json[++i];
      } else if (c == '"') {
        return out;
      } else {
        out += c;
      }
    }
    return out;
  }
  int end = at;
  while (end < (int)json.length() && json[end] != ',' && json[end] != '}') end++;
  String raw = json.substring(at, end);
  raw.trim();
  return raw;
}

static bool jsonBool(const String &json, const char *key) {
  return jsonString(json, key) == "true";
}

static String hmacHex(const String &key, const String &message) {
  uint8_t out[32];
  mbedtls_md_hmac(mbedtls_md_info_from_type(MBEDTLS_MD_SHA256), (const uint8_t *)key.c_str(), key.length(),
                  (const uint8_t *)message.c_str(), message.length(), out);
  char hex[65];
  for (int i = 0; i < 32; i++) sprintf(hex + i * 2, "%02x", out[i]);
  hex[64] = 0;
  return String(hex);
}

/* ------------------------------------------------------------------ state handling */
static const char *stateName(DeviceState value) {
  static const char *names[] = {"offline", "idle", "listening", "thinking", "speaking", "pending", "denied"};
  return value <= ST_DENIED ? names[value] : "?";
}

static void setState(DeviceState next) {
  if (state == next) return;
  Serial.printf("[state] %s -> %s\n", stateName(state), stateName(next));
  state = next;
  stateSince = millis();
  if (next != ST_LISTENING) micLevel = 0;
}

static void setVolume(int level, bool save) {
  if (level < 0) level = 0;
  if (level > 10) level = 10;
  volumeLevel = level;
  /* level 10 = full scale, 3 dB per step, 0 = silent */
  volumeGain = level == 0 ? 0 : (int32_t)(65536.0f * powf(10.0f, -3.0f * (10 - level) / 20.0f));
  if (save) prefs.putUChar("volume", volumeLevel);
}

static void flash(uint8_t r, uint8_t g, uint8_t b, uint32_t ms) {
  flashColor = ((uint32_t)r << 16) | ((uint32_t)g << 8) | b;
  flashUntil = millis() + ms;
}

static void chime(uint16_t frequency, uint32_t ms) {
  chimeFrequency = frequency;
  chimeSamples = SAMPLE_RATE * ms / 1000;
}

/* ------------------------------------------------------------------ network */
static bool writeAll(const uint8_t *data, size_t length) {
  size_t done = 0;
  uint32_t started = millis();
  while (done < length) {
    if (!client.connected()) return false;
    size_t written = client.write(data + done, length - done);
    if (written == 0) {
      if (millis() - started > 3000) return false;
      delay(2);
      continue;
    }
    done += written;
  }
  return true;
}

static bool sendFrame(uint8_t type, const uint8_t *payload, uint32_t length) {
  if (!connected && type != F_HELLO) return false;
  uint8_t header[5] = {type, (uint8_t)(length >> 24), (uint8_t)(length >> 16), (uint8_t)(length >> 8), (uint8_t)length};
  bool ok;
  xSemaphoreTake(sendMutex, portMAX_DELAY);
  ok = writeAll(header, 5) && (length == 0 || writeAll(payload, length));
  xSemaphoreGive(sendMutex);
  return ok;
}

static bool sendJson(uint8_t type, const String &json) {
  return sendFrame(type, (const uint8_t *)json.c_str(), json.length());
}

static void sendEvent(const char *event) {
  sendJson(F_EVENT, String("{\"event\":\"") + event + "\"}");
}

/* read exactly n bytes, giving up after timeoutMs without progress */
static bool readExact(uint8_t *target, size_t n, uint32_t timeoutMs) {
  size_t done = 0;
  uint32_t last = millis();
  while (done < n) {
    if (!client.connected()) return false;
    int available = client.available();
    if (available > 0) {
      int got = client.read(target + done, min((size_t)available, n - done));
      if (got > 0) {
        done += got;
        last = millis();
        continue;
      }
    }
    if (millis() - last > timeoutMs) return false;
    delay(1);
  }
  return true;
}

static bool handshake() {
  uint8_t header[5];
  if (!readExact(header, 5, 5000) || header[0] != F_CHALLENGE) return false;
  uint32_t length = ((uint32_t)header[1] << 24) | ((uint32_t)header[2] << 16) | ((uint32_t)header[3] << 8) | header[4];
  if (length > 1024) return false;
  String challenge;
  challenge.reserve(length);
  for (uint32_t i = 0; i < length; i++) {
    uint8_t c;
    if (!readExact(&c, 1, 5000)) return false;
    challenge += (char)c;
  }
  String nonce = jsonString(challenge, "nonce");
  if (nonce.length() < 16) return false;
  String hello = String("{\"id\":\"") + deviceId + "\",\"fw\":\"" FIRMWARE_VERSION "\",\"proto\":" + PROTOCOL_VERSION
                 + ",\"name\":\"" + jsonEscape(DEVICE_NAME) + "\",\"mac\":\"" + WiFi.macAddress()
                 + "\",\"hmac\":\"" + hmacHex(DEVICE_KEY, nonce + ":" + deviceId) + "\"}";
  return sendJson(F_HELLO, hello);
}

static void handleControl(uint8_t type, const String &json) {
  switch (type) {
    case F_WELCOME: {
      String name = jsonString(json, "name");
      if (name.length()) serverName = name;
      String st = jsonString(json, "state");
      setState(st == "pending" ? ST_PENDING : st == "denied" ? ST_DENIED : ST_IDLE);
      Serial.printf("[net] connected to STEM as %s (%s)\n", deviceId.c_str(), serverName.c_str());
      break;
    }
    case F_PLAY_END: {
      bool wasDiscarding = discardPlay;
      discardPlay = false;
      if (wasDiscarding || jsonBool(json, "cancelled")) break;
      listenAfterPlay = jsonBool(json, "listen");
      playEndReceived = true;
      if (state != ST_SPEAKING && playAvailable() == 0) {
        /* empty answer: nothing to play */
        setState(ST_IDLE);
      }
      break;
    }
    case F_STATE: {
      String st = jsonString(json, "state");
      if (st == "idle") {
        if (state == ST_LISTENING || state == ST_THINKING || state == ST_PENDING || state == ST_DENIED) setState(ST_IDLE);
      } else if (st == "thinking") {
        setState(ST_THINKING);
      } else if (st == "pending") {
        setState(ST_PENDING);
      } else if (st == "denied") {
        setState(ST_DENIED);
      } else if (st == "error") {
        flash(255, 0, 0, 1200);
        chime(220, 250);
        setState(ST_IDLE);
      }
      break;
    }
    case F_STOP_LISTEN:
      if (state == ST_LISTENING) stopListening(false);
      break;
    case F_CMD: {
      String cmd = jsonString(json, "cmd");
      if (cmd == "volume") {
        setVolume(jsonString(json, "value").toInt(), true);
        volumeShownUntil = millis() + 1500;
      } else if (cmd == "chime") {
        chime(880, 120);
      } else if (cmd == "reboot") {
        delay(200);
        ESP.restart();
      }
      break;
    }
    case F_ERROR:
      Serial.printf("[net] server error: %s\n", jsonString(json, "message").c_str());
      break;
    default:
      break;
  }
}

/* PLAY payload goes straight into the ring buffer; waits for space so TCP gives back pressure */
static bool receivePlay(uint32_t length) {
  static uint8_t chunk[1024];
  uint32_t remaining = length;
  bool odd = false;
  uint8_t oddByte = 0;
  while (remaining > 0) {
    uint32_t n = min(remaining, (uint32_t)sizeof(chunk));
    if (!readExact(chunk, n, 10000)) return false;
    remaining -= n;
    if (discardPlay) continue;
    uint32_t i = 0;
    if (odd) {
      int16_t sample = (int16_t)(oddByte | (chunk[0] << 8));
      while (playFree() == 0 && !discardPlay) delay(5);
      playBuffer[playHead] = sample;
      playHead = (playHead + 1) % PLAY_BUFFER_SAMPLES;
      i = 1;
      odd = false;
    }
    for (; i + 1 < n; i += 2) {
      while (playFree() == 0 && !discardPlay) delay(5);
      if (discardPlay) break;
      playBuffer[playHead] = (int16_t)(chunk[i] | (chunk[i + 1] << 8));
      playHead = (playHead + 1) % PLAY_BUFFER_SAMPLES;
    }
    if (i < n && !discardPlay) {
      odd = true;
      oddByte = chunk[i];
    }
    if (!discardPlay && state != ST_SPEAKING && state != ST_LISTENING) {
      playEndReceived = false;  // a new answer starts
      setState(ST_SPEAKING);
    }
  }
  return true;
}

static void networkTask(void *) {
  uint32_t backoff = 1000;
  uint32_t lastPing = 0;
  for (;;) {
    if (WiFi.status() != WL_CONNECTED) {
      connected = false;
      setState(ST_OFFLINE);
      delay(500);
      continue;
    }
    if (!connected) {
      client.stop();
      Serial.printf("[net] connecting to %s:%d\n", SERVER_HOST, SERVER_PORT);
      if (client.connect(SERVER_HOST, SERVER_PORT, 3000)) {
        client.setNoDelay(true);
        if (handshake()) {
          connected = true;
          lastServerData = millis();
          lastPing = millis();
          backoff = 1000;
          continue;
        }
        Serial.println("[net] handshake failed");
      }
      client.stop();
      setState(ST_OFFLINE);
      delay(backoff);
      backoff = min(backoff * 2, (uint32_t)30000);
      continue;
    }

    if (!client.connected() || millis() - lastServerData > 30000) {
      Serial.println("[net] connection lost");
      connected = false;
      client.stop();
      setState(ST_OFFLINE);
      continue;
    }
    if (millis() - lastPing > 10000) {
      lastPing = millis();
      sendFrame(F_PING, nullptr, 0);
    }
    if (client.available() < 5) {
      delay(5);
      continue;
    }
    uint8_t header[5];
    if (!readExact(header, 5, 5000)) {
      connected = false;
      continue;
    }
    lastServerData = millis();
    uint8_t type = header[0];
    uint32_t length = ((uint32_t)header[1] << 24) | ((uint32_t)header[2] << 16) | ((uint32_t)header[3] << 8) | header[4];
    if (length > MAX_FRAME_PAYLOAD) {
      Serial.println("[net] frame too large");
      connected = false;
      continue;
    }
    if (type == F_PLAY) {
      if (!receivePlay(length)) connected = false;
      continue;
    }
    String json;
    json.reserve(length);
    bool ok = true;
    uint8_t buf[256];
    uint32_t remaining = length;
    while (remaining > 0 && ok) {
      uint32_t n = min(remaining, (uint32_t)sizeof(buf));
      ok = readExact(buf, n, 5000);
      for (uint32_t i = 0; ok && i < n; i++) json += (char)buf[i];
      remaining -= n;
    }
    if (!ok) {
      connected = false;
      continue;
    }
    if (type != F_PONG) handleControl(type, json);
  }
}

/* ------------------------------------------------------------------ conversation actions */
static void startListening(bool byWakeWord) {
  if (!connected) {
    flash(255, 80, 0, 800);
    return;
  }
  if (muted) {
    flash(255, 0, 0, 800);
    return;
  }
  if (state == ST_PENDING || state == ST_DENIED) {
    flash(255, 120, 0, 800);
    return;
  }
  /* after the wake word people keep talking, a beep would cover the start of the question */
  if (!byWakeWord) chime(880, 90);
  setState(ST_LISTENING);
  sendJson(F_EVENT, String("{\"event\":\"listen_start\",\"wake\":") + (byWakeWord ? "true" : "false") + "}");
}

static void stopListening(bool userStopped) {
  if (state != ST_LISTENING) return;
  if (userStopped) sendEvent("listen_stop");
  chime(660, 70);
  setState(ST_THINKING);
}

static void interruptSpeaking() {
  discardPlay = true;
  clearPlayRequest = true;
  playEndReceived = false;
  listenAfterPlay = false;
  sendEvent("cancel");
}

/* ------------------------------------------------------------------ wake word */
#if HAS_WAKE_WORD
static WakeWord wakeWord;
static StreamBufferHandle_t wakeStream = nullptr;
static volatile bool wakeResetRequest = true;

/* runs the model next to the audio task, so a slow inference never blocks the I2S DMA */
static void wakeTask(void *) {
  static int16_t chunk[MIC_CHUNK];
  for (;;) {
    size_t got = xStreamBufferReceive(wakeStream, chunk, sizeof(chunk), portMAX_DELAY);
    if (wakeResetRequest) {
      wakeResetRequest = false;
      wakeWord.reset();
    }
    if (got == 0) continue;
    static uint32_t lastReport = 0;
    if (millis() - lastReport > 5000) {
      lastReport = millis();
      uint8_t peak = wakeWord.takeMaxProbability();
      if (peak > 25) Serial.printf("[wake] highest probability in the last 5 s: %.2f\n", peak / 255.0f);
    }
    if (wakeWord.process(chunk, got / sizeof(int16_t)) && state == ST_IDLE) {
      Serial.printf("[wake] detected (p=%u)\n", wakeWord.lastProbability());
      startListening(true);
    }
  }
}
#endif

/* ------------------------------------------------------------------ audio */
static i2s_config_t i2sConfig = {
    .mode = (i2s_mode_t)(I2S_MODE_MASTER | I2S_MODE_TX | I2S_MODE_RX),
    .sample_rate = SAMPLE_RATE,
    .bits_per_sample = I2S_BITS_PER_SAMPLE_32BIT,
    /* both slots: which slot carries the microphone differs between core versions (see MIC_SLOT) */
    .channel_format = I2S_CHANNEL_FMT_RIGHT_LEFT,
    .communication_format = I2S_COMM_FORMAT_STAND_I2S,
    .intr_alloc_flags = ESP_INTR_FLAG_LEVEL1,
    .dma_buf_count = 6,
    .dma_buf_len = MIC_CHUNK,
    .use_apll = false,
    .tx_desc_auto_clear = true,
    .fixed_mclk = 0};

static i2s_pin_config_t i2sPins = {
    .mck_io_num = I2S_PIN_NO_CHANGE,
    .bck_io_num = I2S_BCK_PIN,
    .ws_io_num = I2S_WS_PIN,
    .data_out_num = I2S_OUT_PIN,
    .data_in_num = I2S_IN_PIN};

static void speakerEnable(bool on) {
  static bool enabled = false;
  if (on == enabled) return;
  enabled = on;
  digitalWrite(SPEAKER_EN_PIN, on ? HIGH : LOW);
  if (on) delay(5);
}

static void audioTask(void *) {
  static int32_t micStereo[MIC_CHUNK * 2];
  static int32_t micRaw[MIC_CHUNK];
  static int32_t out[MIC_CHUNK * 2];
  int micSlot = MIC_SLOT;
  uint32_t slotLowBits[2] = {0, 0};
  uint32_t slotStart = 0;
  static int16_t micFrame[MIC_FRAME];
  static int16_t wakeChunk[MIC_CHUNK];
  bool wakeFeeding = false;
  size_t micFill = 0;
  float dc = 0;
  int64_t previousRaw = 0;
  bool havePreviousRaw = false;
  bool dcReady = false;
  float levelSmooth = 0;
  uint32_t chimePhase = 0;
  uint32_t lastSound = 0;

  for (;;) {
    if (clearPlayRequest) {
      playTail = playHead;
      clearPlayRequest = false;
      chimeSamples = 0;
    }

    bool haveChime = chimeSamples > 0;
    bool havePlay = playAvailable() > 0;

    if (haveChime || havePlay) {
      /* ----- output: the mic is ignored while the speaker plays (no echo cancellation on board) */
      speakerEnable(true);
      lastSound = millis();
      uint32_t peak = 0;
      for (int i = 0; i < MIC_CHUNK; i++) {
        int32_t sample = 0;
        if (chimeSamples > 0) {
          float env = chimeSamples < 400 ? chimeSamples / 400.0f : 1.0f;
          sample = (int32_t)(sinf(2.0f * PI * chimeFrequency * chimePhase / SAMPLE_RATE) * 7000.0f * env);
          chimePhase++;
          chimeSamples--;
        } else if (playAvailable() > 0) {
          sample = playBuffer[playTail];
          playTail = (playTail + 1) % PLAY_BUFFER_SAMPLES;
        }
        uint32_t magnitude = abs(sample);
        if (magnitude > peak) peak = magnitude;
        out[2 * i] = out[2 * i + 1] = (int32_t)(((int64_t)sample * volumeGain));
      }
      if (chimeSamples == 0) chimePhase = 0;
      speakerLevel = (uint8_t)min((uint32_t)255, peak >> 6);
      size_t written;
      i2s_write(I2S_PORT, out, sizeof(out), &written, portMAX_DELAY);
      /* keep the microphone DMA drained */
      size_t dropped;
      i2s_read(I2S_PORT, micStereo, sizeof(micStereo), &dropped, 0);
      micFill = 0;
      continue;
    }

    speakerLevel = 0;
    if (state == ST_SPEAKING && playEndReceived && playAvailable() == 0) {
      playEndReceived = false;
      sendEvent("playback_done");
      if (listenAfterPlay && !muted) {
        listenAfterPlay = false;
        startListening();
      } else {
        setState(ST_IDLE);
      }
    }
    /* while listening the amplifier is off, its idle hiss would end up in the recording */
    if (millis() - lastSound > SPEAKER_OFF_DELAY_MS || state == ST_LISTENING) speakerEnable(false);

    /* ----- input */
    size_t bytesRead = 0;
    i2s_read(I2S_PORT, micStereo, sizeof(micStereo), &bytesRead, portMAX_DELAY);
    int count = bytesRead / sizeof(int32_t) / 2;
    if (micSlot < 0) {
      /* find the slot with the microphone: its 24 bit data has noise in bits 8..13, the empty slot not */
      if (slotStart == 0) slotStart = millis();
      for (int i = 0; i < count; i++) {
        for (int slot = 0; slot < 2; slot++) {
          if ((uint32_t)micStereo[2 * i + slot] & 0x3F00) slotLowBits[slot]++;
        }
      }
      if (millis() - slotStart > 2000) {
        micSlot = slotLowBits[1] > slotLowBits[0] ? 1 : 0;
        Serial.printf("[mic] slot 0: %lu, slot 1: %lu samples with low bits -> using slot %d\n",
                      (unsigned long)slotLowBits[0], (unsigned long)slotLowBits[1], micSlot);
      }
    }
    {
      static uint32_t lastSlotReport = 0;
      if (millis() < 30000 && millis() - lastSlotReport > 1000 && count > 2) {
        lastSlotReport = millis();
        Serial.printf("[mic] slot0 %08lx %08lx %08lx | slot1 %08lx %08lx %08lx\n",
                      (unsigned long)micStereo[0], (unsigned long)micStereo[2], (unsigned long)micStereo[4],
                      (unsigned long)micStereo[1], (unsigned long)micStereo[3], (unsigned long)micStereo[5]);
      }
    }
    for (int i = 0; i < count; i++) micRaw[i] = micStereo[2 * i + (micSlot < 0 ? 0 : micSlot)];
    {
      /* diagnostics: which bits of the 32 bit I2S word carry data, and the raw range, once per second */
      static uint32_t bitsOr = 0, bitsAnd = 0xFFFFFFFF, lastRawReport = 0;
      static int32_t rawMin = INT32_MAX, rawMax = INT32_MIN;
      for (int i = 0; i < count; i++) {
        bitsOr |= (uint32_t)micRaw[i];
        bitsAnd &= (uint32_t)micRaw[i];
        if (micRaw[i] < rawMin) rawMin = micRaw[i];
        if (micRaw[i] > rawMax) rawMax = micRaw[i];
      }
      if (millis() - lastRawReport > 1000 && count > 4) {
        lastRawReport = millis();
        Serial.printf("[mic] raw min %08lx max %08lx | bits ever 1: %08lx, always 1: %08lx | sample %08lx %08lx %08lx %08lx\n",
                      (unsigned long)rawMin, (unsigned long)rawMax, (unsigned long)bitsOr, (unsigned long)bitsAnd,
                      (unsigned long)micRaw[0], (unsigned long)micRaw[1], (unsigned long)micRaw[2], (unsigned long)micRaw[3]);
        bitsOr = 0;
        bitsAnd = 0xFFFFFFFF;
        rawMin = INT32_MAX;
        rawMax = INT32_MIN;
      }
    }
    bool streaming = state == ST_LISTENING && !muted && connected && millis() - lastSound > MIC_BLANK_MS;
    uint32_t peak = 0;
    for (int i = 0; i < count; i++) {
      int64_t raw = micRaw[i];
      if (havePreviousRaw) {
        int64_t jump = raw - previousRaw;
        if (jump > MIC_WRAP / 2) raw -= MIC_WRAP * ((jump + MIC_WRAP / 2) / MIC_WRAP);
        else if (jump < -MIC_WRAP / 2) raw += MIC_WRAP * ((-jump + MIC_WRAP / 2) / MIC_WRAP);
      }
      /* keep the tracked value near the real range, so it cannot drift away over hours */
      if (raw > INT32_MAX) raw -= MIC_WRAP;
      if (raw < INT32_MIN) raw += MIC_WRAP;
      previousRaw = raw;
      havePreviousRaw = true;
      float sample = (float)raw / 16384.0f * MIC_GAIN;
      if (!dcReady) {
        dc = sample;  // start at the large DC offset of the microphone instead of zero
        dcReady = true;
      }
      dc += 0.001f * (sample - dc);
      int32_t value = (int32_t)(sample - dc);
      if (value > 32767) value = 32767;
      if (value < -32768) value = -32768;
      uint32_t magnitude = abs(value);
      if (magnitude > peak) peak = magnitude;
      wakeChunk[i] = (int16_t)value;
      if (streaming) {
        micFrame[micFill++] = (int16_t)value;
        if (micFill == MIC_FRAME) {
          sendFrame(F_AUDIO, (const uint8_t *)micFrame, sizeof(micFrame));
          micFill = 0;
        }
      }
    }
    if (!streaming) micFill = 0;
#if HAS_WAKE_WORD
    /* listen for the wake word only when idle; not right after the speaker played (echo of the room) */
    bool feed = wakeWord.ready() && state == ST_IDLE && !muted && connected && millis() - lastSound > 700;
    if (feed) {
      if (!wakeFeeding) wakeResetRequest = true;
      xStreamBufferSend(wakeStream, wakeChunk, count * sizeof(int16_t), 0);
    }
    wakeFeeding = feed;
#endif
    levelSmooth = levelSmooth * 0.7f + min(255.0f, peak / 40.0f) * 0.3f;
    micLevel = streaming ? (uint8_t)levelSmooth : 0;
  }
}

/* ------------------------------------------------------------------ LEDs */
static uint8_t gammaTable[256];

static uint32_t color(float r, float g, float b, float scale) {
  auto c = [&](float v) -> uint8_t {
    int x = (int)(v * scale * LED_BRIGHTNESS / 255.0f);
    return gammaTable[constrain(x, 0, 255)];
  };
  return leds.Color(c(r), c(g), c(b));
}

static void ledTask(void *) {
  for (int i = 0; i < 256; i++) gammaTable[i] = (uint8_t)(powf(i / 255.0f, 1.8f) * 255.0f + 0.5f);
  uint32_t tick = 0;
  for (;;) {
    tick++;
    uint32_t now = millis();
    float t = now / 1000.0f;
    leds.clear();
    if (now < flashUntil) {
      uint32_t c = flashColor;
      float blink = ((now / 150) % 2) ? 1.0f : 0.3f;
      for (int i = 0; i < LED_COUNT; i++) leds.setPixelColor(i, color((c >> 16) & 0xFF, (c >> 8) & 0xFF, c & 0xFF, blink));
    } else if (now < volumeShownUntil) {
      /* volume as a bar over the six LEDs */
      float lit = volumeLevel * LED_COUNT / 10.0f;
      for (int i = 0; i < LED_COUNT; i++) {
        float part = constrain(lit - i, 0.0f, 1.0f);
        leds.setPixelColor(i, color(255, 255, 255, 0.05f + 0.95f * part));
      }
    } else {
      switch (state) {
        case ST_OFFLINE: {
          float pulse = 0.5f + 0.5f * sinf(t * 2.0f);
          leds.setPixelColor(0, color(255, 90, 0, 0.05f + 0.25f * pulse));
          break;
        }
        case ST_IDLE:
          break;
        case ST_LISTENING: {
          float level = 0.25f + 0.75f * micLevel / 255.0f;
          for (int i = 0; i < LED_COUNT; i++) leds.setPixelColor(i, color(0, 200, 255, level));
          break;
        }
        case ST_THINKING: {
          float pos = fmodf(t * 8.0f, LED_COUNT);
          for (int i = 0; i < LED_COUNT; i++) {
            float d = fabsf(i - pos);
            d = min(d, LED_COUNT - d);
            leds.setPixelColor(i, color(170, 60, 255, max(0.05f, 1.0f - d * 0.6f)));
          }
          break;
        }
        case ST_SPEAKING: {
          float level = 0.2f + 0.8f * speakerLevel / 255.0f;
          for (int i = 0; i < LED_COUNT; i++) leds.setPixelColor(i, color(255, 255, 255, level));
          break;
        }
        case ST_PENDING: {
          float pulse = 0.5f + 0.5f * sinf(t * 1.5f);
          for (int i = 0; i < LED_COUNT; i++) leds.setPixelColor(i, color(255, 150, 0, 0.1f + 0.4f * pulse));
          break;
        }
        case ST_DENIED:
          leds.setPixelColor(0, color(255, 0, 0, 0.2f));
          break;
      }
      if (muted && state != ST_LISTENING) {
        /* muted: one steady red LED next to the switch */
        leds.setPixelColor(LED_COUNT - 1, color(255, 0, 0, 0.35f));
      }
    }
    leds.show();
    delay(25);
  }
}

/* ------------------------------------------------------------------ touch */
struct TouchPad {
  uint8_t pin;
  float baseline;
  bool down;
  uint32_t changed;
};

static TouchPad pads[3] = {{TOUCH_LEFT, 0, false, 0}, {TOUCH_CENTER, 0, false, 0}, {TOUCH_RIGHT, 0, false, 0}};

static void calibrateTouch() {
  for (auto &pad : pads) {
    float sum = 0;
    for (int i = 0; i < 16; i++) {
      sum += touchRead(pad.pin);
      delay(5);
    }
    pad.baseline = sum / 16.0f;
  }
  Serial.printf("[touch] baselines left %.0f, center %.0f, right %.0f (threshold +-%.0f%%)\n", pads[0].baseline,
                pads[1].baseline, pads[2].baseline, TOUCH_SENSITIVITY * 100);
}

/* returns true once per tap (on release, debounced) */
static bool pollPad(TouchPad &pad) {
  float value = touchRead(pad.pin);
  /* the ESP32-S3 reading rises on touch, older chips fall: accept both directions */
  float delta = fabsf(value - pad.baseline) / pad.baseline;
  /* hysteresis: a touch starts above the sensitivity and ends below half of it */
  bool touching = pad.down ? delta > TOUCH_SENSITIVITY * 0.5f : delta > TOUCH_SENSITIVITY;
  uint32_t now = millis();
  if (!touching) pad.baseline += 0.01f * (value - pad.baseline);
  if (touching && !pad.down && now - pad.changed > 60) {
    Serial.printf("[touch] pad %d pressed, change %.1f%%\n", pad.pin, delta * 100);
  }
  if (touching != pad.down && now - pad.changed > 60) {
    pad.down = touching;
    pad.changed = now;
    return touching;  // trigger on press for a snappy feeling
  }
  return false;
}

static void onCenterTap() {
  Serial.printf("[touch] center tap in state %s%s\n", stateName(state), muted ? " (muted)" : "");
  switch (state) {
    case ST_IDLE:
      startListening();
      break;
    case ST_LISTENING:
      stopListening(true);
      break;
    case ST_SPEAKING:
      interruptSpeaking();
      startListening();
      break;
    case ST_THINKING:
      interruptSpeaking();  // the answer may already be on its way
      setState(ST_IDLE);
      flash(170, 60, 255, 300);
      break;
    default:
      startListening();  // gives the right error flash
      break;
  }
}

static void touchTask(void *) {
  calibrateTouch();
  if (MUTE_ACTIVE_LEVEL >= 0) {
    muted = digitalRead(MUTE_PIN) == (MUTE_ACTIVE_LEVEL ? HIGH : LOW);
    Serial.printf("[mute] switch pin reads %d -> %s\n", digitalRead(MUTE_PIN), muted ? "MUTED" : "microphone on");
  }
  uint32_t lastReport = 0;
  for (;;) {
    /* raw touch readings for the first two minutes, to check TOUCH_SENSITIVITY */
    if (millis() < 120000 && millis() - lastReport > 2000) {
      lastReport = millis();
      Serial.printf("[touch] raw left %u center %u right %u\n", (unsigned)touchRead(pads[0].pin),
                    (unsigned)touchRead(pads[1].pin), (unsigned)touchRead(pads[2].pin));
    }
    if (pollPad(pads[1])) onCenterTap();
    if (pollPad(pads[0])) {
      setVolume(volumeLevel - 1, true);
      volumeShownUntil = millis() + 1500;
      if (state != ST_SPEAKING && state != ST_LISTENING) chime(660, 60);
    }
    if (pollPad(pads[2])) {
      setVolume(volumeLevel + 1, true);
      volumeShownUntil = millis() + 1500;
      if (state != ST_SPEAKING && state != ST_LISTENING) chime(990, 60);
    }

    if (MUTE_ACTIVE_LEVEL >= 0) {
      bool nowMuted = digitalRead(MUTE_PIN) == (MUTE_ACTIVE_LEVEL ? HIGH : LOW);
      if (nowMuted != muted) {
        muted = nowMuted;
        Serial.printf("[mute] %s\n", muted ? "MUTED" : "microphone on");
        if (muted && state == ST_LISTENING) {
          interruptSpeaking();
          setState(ST_IDLE);
        }
        sendJson(F_EVENT, String("{\"event\":\"mute\",\"value\":") + (muted ? "true" : "false") + "}");
      }
    }

    /* safety timeouts in case the server goes quiet */
    uint32_t inState = millis() - stateSince;
    if (state == ST_LISTENING && inState > MAX_LISTEN_MS) stopListening(true);
    if (state == ST_THINKING && inState > THINKING_TIMEOUT_MS) {
      flash(255, 0, 0, 800);
      setState(ST_IDLE);
    }
    delay(20);
  }
}

/* ------------------------------------------------------------------ setup / loop */
void setup() {
  Serial.begin(115200);
  delay(200);

  uint8_t mac[6];
  esp_read_mac(mac, ESP_MAC_WIFI_STA);
  char id[32];
  snprintf(id, sizeof(id), "mirra-voice-%02x%02x%02x", mac[3], mac[4], mac[5]);
  deviceId = id;
  Serial.printf("\nMirra voice satellite %s, firmware " FIRMWARE_VERSION "\n", deviceId.c_str());

  pinMode(SPEAKER_EN_PIN, OUTPUT);
  digitalWrite(SPEAKER_EN_PIN, LOW);
  pinMode(MUTE_PIN, INPUT_PULLUP);

  leds.begin();
  leds.clear();
  leds.show();

  prefs.begin("mirra-voice", false);
  setVolume(prefs.getUChar("volume", DEFAULT_VOLUME), false);

  playBuffer = (int16_t *)ps_malloc(PLAY_BUFFER_SAMPLES * sizeof(int16_t));
  if (!playBuffer) {
    Serial.println("PSRAM missing - select 'OPI PSRAM' in the board settings");
    for (;;) {
      leds.fill(leds.Color(80, 0, 0));
      leds.show();
      delay(500);
      leds.clear();
      leds.show();
      delay(500);
    }
  }

  i2s_driver_install(I2S_PORT, &i2sConfig, 0, nullptr);
  i2s_set_pin(I2S_PORT, &i2sPins);
  i2s_zero_dma_buffer(I2S_PORT);

  sendMutex = xSemaphoreCreateMutex();

  WiFi.mode(WIFI_STA);
  WiFi.setHostname(deviceId.c_str());
  WiFi.setSleep(false);
  WiFi.setAutoReconnect(true);
  WiFi.begin(WIFI_SSID, WIFI_PASSWORD);

  if (strlen(OTA_PASSWORD) > 0) {
    ArduinoOTA.setHostname(deviceId.c_str());
    ArduinoOTA.setPassword(OTA_PASSWORD);
    ArduinoOTA.onStart([]() {
      connected = false;
      client.stop();
      flash(0, 0, 255, 600000);
    });
    ArduinoOTA.begin();
  }

#if HAS_WAKE_WORD
  if (wakeWord.begin(hey_mirra_tflite, WAKE_WORD_CUTOFF, WAKE_WORD_WINDOW)) {
    wakeStream = xStreamBufferCreate(MIC_CHUNK * sizeof(int16_t) * 8, MIC_CHUNK * sizeof(int16_t));
    xTaskCreatePinnedToCore(wakeTask, "wake", 8192, nullptr, 4, nullptr, 0);
  } else {
    Serial.println("[wake] wake word disabled, tap to talk");
  }
#endif
  xTaskCreatePinnedToCore(audioTask, "audio", 8192, nullptr, 5, nullptr, 1);
  xTaskCreatePinnedToCore(networkTask, "net", 8192, nullptr, 3, nullptr, 0);
  xTaskCreatePinnedToCore(ledTask, "led", 4096, nullptr, 1, nullptr, 0);
  xTaskCreatePinnedToCore(touchTask, "touch", 4096, nullptr, 2, nullptr, 1);
}

void loop() {
  if (strlen(OTA_PASSWORD) > 0 && WiFi.status() == WL_CONNECTED) ArduinoOTA.handle();
  delay(50);
}
